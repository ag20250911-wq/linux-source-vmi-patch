## 6.8.0/arch/x86/kvm/Kconfig
```kconfig
config KVM_INTROSPECTION
    bool "KVM introspection support"
    depends on KVM
    help
      Provides introspection capabilities for KVM guests.
      Required for libmicrovmi/KVMI.

config KVMI
    tristate
    depends on KVM_INTROSPECTION
    default m
```
